## dts/bindings/sensor/efog,ec11-ish.yaml
```yaml
description: |
  Sensor driver for the "Alps EC11"-ish rotary encoders

compatible: "efog,ec11-ish"

properties:
  a-gpios:
    type: phandle-array
    required: true
    description: A pin for the encoder
  b-gpios:
    type: phandle-array
    required: true
    description: A pin for the encoder
  steps:
    type: int
    description: Number of pulses in one full rotation
    required: true
  pulses:
    type: int
    description: Number of pulses for one tick
    required: true
```

## src/Kconfig
```kconfig
# Copyright (c) 2020 The ZMK Contributors
# SPDX-License-Identifier: MIT

menuconfig EC11_ISH
    bool "EC11-ish incremental encoder"
    default y
    depends on GPIO
    help
      Enable driver for EC11-ish incremental encoder sensors.

if EC11_ISH

config EC11_ISH_DEBOUNCE_MS
    int "Per-line debounce delay, msec"
    default 0
    help
      Minimum time in milliseconds between samples on each encoder line (A and B).
      After an edge is detected, the interrupt is suppressed for this duration
      before the line state is sampled and any trigger is fired.

config EC11_ISH_MAX_RECURSION_DEPTH
    int "Maximum recursion depth for repeated reads"
    default 250

config EC11_ISH_TRIGGER_WINDOW
    int "Trigger window, msec"
    default 350

config EC11_ISH_COMPENSATE_MISSES
    bool "Compensate for missed pulses"
    default y

if EC11_ISH_COMPENSATE_MISSES

config EC11_ISH_COMPENSATE_MINIMUM_HALF
    bool "Compensate only if there are at least half pulses"
    default y

endif # EC11_ISH_COMPENSATE_MISSES

endif # EC11_ISH
```
